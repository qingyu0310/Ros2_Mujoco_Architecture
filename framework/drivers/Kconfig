## framework/drivers/Kconfig
```kconfig
# drivers/Kconfig —— 底层通讯/设备驱动层。
# 架构层能力默认 n，由业务层 select 拉起。
#
# 命名族（照父架构 framework/drivers/Kconfig，不许自创前缀）：
#   DUST_COM_*  通讯驱动（UART / USB / RS485 / CAN）
#   DUST_DEV_*  设备驱动（GPIO / PWM）
#
# 骨架阶段没有任何实现。新增驱动时在这里加 config，
# 并在 CMakeLists.txt 里按同一个符号建 target。

config DUST_COM_MUJOCO
    bool "MuJoCo simulation driver"
    default n
    help
      加载 MJCF、推进物理、按 ctrl/qpos 交换过程数据。

config DUST_COM_MUJOCO_VIEWER
    bool "MuJoCo interactive viewer"
    default y
    depends on DUST_COM_MUJOCO
    help
      起 Simulate 界面（窗口与 RenderLoop 在独立线程）。关掉即 headless。
```
